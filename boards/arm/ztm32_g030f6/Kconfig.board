## boards/arm/ztm32_g030f6/Kconfig.board
```kconfig
# STM32 ztm32 development board with STM32G030F6P6 MCU configuration

# Copyright (c) 2022 Sullivan Zeng <2257501878@qq.com>
# SPDX-License-Identifier: Apache-2.0

config BOARD_ZTM32_G030F6
	bool "ZTM32 G030F6P6 Development Board"
	depends on SOC_STM32G030XX
```

## boards/arm/ztm32_g030f6/Kconfig.defconfig
```kconfig
# STM32 ztm32_g030f6 development board with STM32G030F6P6 MCU configuration

# Copyright (c) 2022 Sullivan Zeng <2257501878@qq.com>
# SPDX-License-Identifier: Apache-2.0

if BOARD_ZTM32_G030F6

config BOARD
	default "ztm32_g030f6"

config SPI_STM32_INTERRUPT
	default y
	depends on SPI

endif # BOARD_ZTM32_G030F6
```

## boards/arm/ztm32_g030k8/Kconfig.board
```kconfig
# STM32 ztm32 development board with STM32G030K8T6 MCU configuration

# Copyright (c) 2022 Sullivan Zeng <2257501878@qq.com>
# SPDX-License-Identifier: Apache-2.0

config BOARD_ZTM32_G030K8
	bool "ZTM32 G030K8T6 Development Board"
	depends on SOC_STM32G030XX
```

## boards/riscv/esp32c3_can_motor/Kconfig.board
```kconfig
# ESP32C3 development board with esp32c3 MCU configuration

# Copyright (c) 2022 Sullivan Zeng <2257501878@qq.com>
# SPDX-License-Identifier: Apache-2.0

config BOARD_ESP32C3_CAN_MOTOR
	bool "ESP32C3 can controller Board"
	depends on SOC_ESP32C3

choice SOC_PART_NUMBER
	default SOC_ESP32C3_MINI_N4
endchoice
```

## boards/riscv/esp32c3_can_motor/Kconfig.defconfig
```kconfig
# ESP32C3 development board with ESP32C3 MCU configuration

# Copyright (c) 2022 Sullivan Zeng <2257501878@qq.com>
# SPDX-License-Identifier: Apache-2.0

config BOARD
	default "esp32c3_can_motor"
	depends on BOARD_ESP32C3_CAN_MOTOR

config HEAP_MEM_POOL_SIZE
	default 98304 if WIFI
	default 40960 if BT
	default 4096

choice BT_HCI_BUS_TYPE
	default BT_ESP32 if BT
endchoice
```

## boards/sullivan-project/waveshare_f407ig/Kconfig.board
```kconfig
# STM32 ztm32 development board with STM32G030F6P6 MCU configuration

# Copyright (c) 2022 Sullivan Zeng <2257501878@qq.com>
# SPDX-License-Identifier: Apache-2.0

config BOARD_WAVESHARE_F407IG
	bool "WAVESHARE F407IG Development Board"
	depends on SOC_STM32F407XG
```

## boards/sullivan-project/waveshare_f407ig/Kconfig.defconfig
```kconfig
# Copyright (c) 2022 Sullivan Zeng <2257501878@qq.com>
# SPDX-License-Identifier: Apache-2.0

if BOARD_WAVESHARE_F407IG

config BOARD
	default "waveshare_f407ig_defconfig"

config SPI_STM32_INTERRUPT
	default y
	depends on SPI

endif
```

## boards/sullivan-project/waveshare_f407ig/waveshare_f407ig_defconfig
```kconfig
# SPDX-License-Identifier: Apache-2.0
CONFIG_BOARD_WAVESHARE_F407IG=y
# Zephyr Kernel Configuration
CONFIG_SOC_SERIES_STM32F4X=y

# Platform Configuration
CONFIG_SOC_STM32F407XG=y

# Enable MPU
CONFIG_ARM_MPU=y

# Kernel Options due to Low Memory (8k)
CONFIG_HW_STACK_PROTECTION=y
#CONFIG_MAIN_STACK_SIZE=640
#CONFIG_IDLE_STACK_SIZE=200
#CONFIG_ISR_STACK_SIZE=512

# Serial Drivers
CONFIG_SERIAL=y
CONFIG_UART_INTERRUPT_DRIVEN=y
# enable console
CONFIG_CONSOLE=y
CONFIG_UART_CONSOLE=y

# GPIO Controller
CONFIG_GPIO=y

# Enable Clocks
CONFIG_CLOCK_CONTROL=y

# enable pin controller
CONFIG_PINCTRL=y
```

## boards/sullivan-project/ztm32_g030f6/Kconfig.defconfig
```kconfig
# Copyright (c) 2024 Sullivan Zeng <2257501878@qq.com>
# SPDX-License-Identifier: Apache-2.0

if BOARD_ZTM32_G030F6

config SPI_STM32_INTERRUPT
	default y
	depends on SPI

endif # BOARD_ZTM32_G030F6
```

## boards/sullivan-project/ztm32_g030f6/Kconfig.ztm32_g030f6
```kconfig
# STM32 ztm32 development board with STM32G030F6P6 MCU configuration

# Copyright (c) 2022 Sullivan Zeng <2257501878@qq.com>
# SPDX-License-Identifier: Apache-2.0


config BOARD_ZTM32_G030F6
	select SOC_STM32G030XX
```

## boards/sullivan-project/ztm32_g030f6/board.yml
```yaml
board:
  name: ztm32_g030f6
  vendor: sullivan-project
  socs:
    - name: stm32g030xx
```

## boards/sullivan-project/ztm32_g030k8/Kconfig.defconfig
```kconfig
# STM32 ztm32_g030k8 development board with STM32G030K8T6 MCU configuration

# Copyright (c) 2022 Sullivan Zeng <2257501878@qq.com>
# SPDX-License-Identifier: Apache-2.0

if BOARD_ZTM32_G030K8

config BOARD
	default "ztm32_g030k8"

config SPI_STM32_INTERRUPT
	default y
	depends on SPI

endif # BOARD_ZTM32_G030K8
```

## dts/bindings/sensor/bjrobot,ax12.yaml
```yaml
# Copyright (c) 2023, sullivan986.github.io
# SPDX-License-Identifier: MIT

description: ax12 digital servo

compatible: "bjrobot,ax12"

include: uart-device.yaml

properties:
  reg:
    required: true
  motor-id:
    type: int
    required: true
    description: |
      Interrupt pin. When the sensor is touched, the GPIO is set to high.
      It is used to trigger a fingerprint enroll or match operations.
```

## zephyr/display/Kconfig.st7735r_8080_gpio
```kconfig
config ST7735R_8080_GPIO
	bool "ST7735R display driver"
	default y
	depends on DT_HAS_SITRONIX_ST7735R_ENABLED
	select GPIO
	help
	  Enable driver for ST7735R display driver.
```

## zephyr/display/p144c92b/Kconfig
```kconfig
config ZTM_P144C92B
        bool "P144C92B display driver for 8080 Interface"
        depends on GPIO
        help
          Enable driver for P144C92B display.
```

## zephyr/sensor/Kconfig
```kconfig
# Sensor configuration options

# Copyright (c) 2023 Sullivan
# SPDX-License-Identifier: MIT

rsource "Kconfig.ax12"
```

## zephyr/sensor/Kconfig.ax12
```kconfig
# AX12 motor driver configuration options

# Copyright (c) 2023 Sullivan
# SPDX-License-Identifier: MIT

config AX12
	bool "AX12 motor driver"
	default n
	depends on SERIAL
	select SENSOR
	help
	  Enable driver for AX12 motor driver.

if AX12


endif # AX12
```
